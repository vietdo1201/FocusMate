## firmware/main/Kconfig.projbuild
```kconfig
menu "FocusMate camera hardware gate"

config FOCUSMATE_CAMERA_ENABLE
    bool "Enable OV2640 camera smoke test"
    default n
    help
        Keep disabled until the exact module/PCB revision, 3.3 V/GND, data pins,
        and XCLK source have been physically confirmed and recorded.

config FOCUSMATE_CAMERA_PINOUT_CONFIRMED
    bool "I physically confirmed this exact pinout and XCLK source"
    depends on FOCUSMATE_CAMERA_ENABLE
    default n
    help
        Safety interlock. Enabling camera without this confirmation fails build.

config FOCUSMATE_CAMERA_EXTERNAL_OSCILLATOR
    bool "OV2640 module has its own oscillator (ESP XCLK disconnected)"
    depends on FOCUSMATE_CAMERA_ENABLE
    default y

endmenu
```

## firmware/sdkconfig.defaults
```kconfig
CONFIG_IDF_TARGET="esp32s3"
CONFIG_BT_ENABLED=y
CONFIG_BT_NIMBLE_ENABLED=y
CONFIG_BT_NIMBLE_ROLE_PERIPHERAL=y
CONFIG_BT_NIMBLE_MAX_CONNECTIONS=1
CONFIG_BT_NIMBLE_GAP_SERVICE=y
CONFIG_BT_NIMBLE_SM_LEGACY=y
CONFIG_BT_NIMBLE_SM_SC=y
CONFIG_BT_NIMBLE_NVS_PERSIST=y
CONFIG_ESPTOOLPY_FLASHSIZE_16MB=y
CONFIG_SPIRAM=y
CONFIG_SPIRAM_MODE_OCT=y
CONFIG_SPIRAM_TYPE_AUTO=y
CONFIG_SPIRAM_SPEED_80M=y
CONFIG_ESP_DEFAULT_CPU_FREQ_MHZ_240=y
CONFIG_ESP_DEFAULT_CPU_FREQ_MHZ=240
CONFIG_LOG_DEFAULT_LEVEL_INFO=y
CONFIG_COMPILER_OPTIMIZATION_PERF=y
CONFIG_ESP_WIFI_STATIC_RX_BUFFER_NUM=16
CONFIG_ESP_WIFI_DYNAMIC_RX_BUFFER_NUM=32
CONFIG_ESP_WIFI_DYNAMIC_TX_BUFFER_NUM=32
CONFIG_LWIP_MAX_SOCKETS=12
CONFIG_HTTPD_MAX_REQ_HDR_LEN=1024
CONFIG_SPIFFS_OBJ_NAME_LEN=64
CONFIG_SPIFFS_USE_MTIME=y
CONFIG_ESP_TASK_WDT_TIMEOUT_S=10
CONFIG_PARTITION_TABLE_CUSTOM=y
CONFIG_PARTITION_TABLE_CUSTOM_FILENAME="partitions.csv"
CONFIG_FOCUSMATE_CAMERA_ENABLE=y
CONFIG_FOCUSMATE_CAMERA_PINOUT_CONFIRMED=y
CONFIG_FOCUSMATE_CAMERA_EXTERNAL_OSCILLATOR=y
# The two-stage model supplies the five facial landmarks used by FaceMetaV1.
CONFIG_FLASH_HUMAN_FACE_DETECT_MSRMNP_S8_V1=y
# CONFIG_FLASH_ESPDET_PICO_224_224_FACE is not set
CONFIG_HUMAN_FACE_DETECT_MSRMNP_S8_V1=y
# CONFIG_ESPDET_PICO_224_224_FACE is not set
```
